OUTPUT_FORMAT(binary)
ENTRY(entry)

SECTIONS {
    . = 0x0600;
    
    .text : {
        *(.text)
    }
    
    .rodata : {
        *(.rodata)
    }
    
    .data : {
        *(.data)
    }
    
    .bss : {
        *(.bss)
    }
}